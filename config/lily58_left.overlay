/ {
    encoders {
        compatible = "zmk,encoders";

        left_encoder: encoder_0 {
            compatible = "alps,ec11";
            a-gpios = <&pro_micro 20 GPIO_ACTIVE_HIGH>;
            b-gpios = <&pro_micro 21 GPIO_ACTIVE_HIGH>;
            steps = <4>;
        };
    };
};
